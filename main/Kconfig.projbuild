## main/Kconfig.projbuild
```kconfig
menu "Pin Configuration"
    config LED_WIFI
        int "WiFi LED"
        range 4 33
        default 23
        help
            This pin can be connected to an LED which will be ON when the WiFi
            has connected to an SSID or the SoftAP is active.
            Note: This LED is Active LOW.

    config LED_STATUS
        int "Status LED"
        range 4 33
        default 22
        help
            This pin can be connected to an LED which will be used as a status
            indicator.
            Note: This LED is Active LOW.

    config FACTORY_RESET
        int "Factory Reset"
        range -1 39
        default 15
        help
            This pin can be used to force a factory reset of the configuration.
            Note: Pin 15 is selected as a default since it typically will have
            a pull-up resistor on the module. If you are using the ESP32
            OpenLCB IO Board PCB this should be set to 39. If you want to
            disable this functionality set the value to -1 and the pin will
            always read HIGH.

    config USER_BUTTON
        int "User Button"
        range -1 39
        default 36
        help
            This pin can be used in conjunction with the Factory Reset button
            during startup to have the node enter the bootloader mode to allow
            downloading of firmware via the CAN bus. If you want to disable
            this functionality set the value to -1 and the pin will always
            read HIGH.

    config TWAI_RX_PIN
        int "TWAI (CAN) RX Pin"
        range 4 39
        default 4
        depends on OLCB_ENABLE_TWAI
        help
            This is the ESP32 pin connected to the external CAN Transceiver RX
            pin. A few CAN transceivers that have been tested successfully are:
            MCP2551
            SN6565HVD23x
            TJA1051T/3
            TJA1057GT/3
            IFX1050GVIO

    config TWAI_TX_PIN
        int "TWAI (CAN) TX Pin"
        range 4 33
        default 5
        depends on OLCB_ENABLE_TWAI
        help
            This is the ESP32 pin connected to the external CAN Transceiver TX
            pin. A few CAN transceivers that have been tested successfully are:
            MCP2551
            SN6565HVD23x
            TJA1051T/3
            TJA1057GT/3
            IFX1050GVIO

endmenu

menu "OpenLCB Configuration"
    config OLCB_NODE_ID
        hex "Node ID"
        default 0x05020103FFFF
        help 
            This is the OpenLCB unique node identifier for the ESP32 OpenLCB
            Hub. It is recommended, but not required, to request your own
            identifier range via:
            https://registry.openlcb.org/requestuniqueidrange
            The default node identifier is part of a reserved range of
            identifier values.

    config OLCB_PRINT_ALL_PACKETS
        bool "Print all GridConnect packets"
        default n
        help
            Enabling this option will cause all packets that are sent or
            received to be printed by the ESP32 OpenLCB Hub.

    config OLCB_ENABLE_TWAI
        bool "Enable TWAI (CAN) interface"
        default y
endmenu

menu "WiFi Configuration"
    config WIFI_RESTART_ON_SSID_CONNECT_FAILURE
        bool "Restart if SSID connect fails"
        default y
        help
            By default the ESP32 OpenLCB Hub will wait up to ~3min for the SSID
            connect process to complete, if it does not complete within this
            period it will reboot and try again.

    choice WIFI_MODE
        bool "WiFi Mode"
        config WIFI_MODE_SOFTAP
            bool "SoftAP only"
        config WIFI_MODE_STATION
            bool "Station only"
        config WIFI_MODE_SOFTAP_STATION
            bool "SoftAP and Station"
        config WIFI_MODE_OFF
            bool "Off"
    endchoice

    config WIFI_MODE
        int
        default 0 if WIFI_MODE_OFF
        default 1 if WIFI_MODE_STATION
        default 2 if WIFI_MODE_SOFTAP
        default 3 if WIFI_MODE_SOFTAP_STATION

    config WIFI_HOSTNAME_PREFIX
        string "Hostname prefix"
        default "esp32olcbhub_"
        help
            The OpenLCB node identifier will be appended to this value, ie:
            esp32olcbhub_05020103ffff.

    config WIFI_SOFTAP_SSID
        string "SoftAP SSID"
        depends on WIFI_MODE_SOFTAP || WIFI_MODE_SOFTAP_STATION

    config WIFI_SOFTAP_PASSWORD
        string "SoftAP Password"
        depends on WIFI_MODE_SOFTAP || WIFI_MODE_SOFTAP_STATION

    config WIFI_SOFTAP_CHANNEL
        int "SoftAP Channel"
        default 1
        range 1 14
        depends on WIFI_MODE_SOFTAP || WIFI_MODE_SOFTAP_STATION
        help
            This configures the channel that will be used by the SoftAP. There
            are fourteen channels available to pick from and some are better
            than others. The best channels to pick from are: 1, 6, 11 since
            these do not overlap with other channels.
    
    config WIFI_STATION_SSID
        string "Station SSID"
        depends on WIFI_MODE_STATION || WIFI_MODE_SOFTAP_STATION

    config WIFI_STATION_PASSWORD
        string "Station Password"
        depends on WIFI_MODE_STATION || WIFI_MODE_SOFTAP_STATION

    config TIMEZONE
        string "Timezone"
        default "UTC0"
        depends on WIFI_MODE_STATION || WIFI_MODE_SOFTAP_STATION
        help
            This is the timezone that the ESP32 OpenLCB Hub is running in.
            The value must follow POSIX notation.
            A few common values:
            * PST8PDT,M3.2.0,M11.1.0 -- UTC-8 with automatic DST adjustment
            * MST7MDT,M3.2.0,M11.1.0 -- UTC-7 with automatic DST adjustment
            * CST6CDT,M3.2.0,M11.1.0 -- UTC-6 with automatic DST adjustment
            * EST5EDT,M3.2.0,M11.1.0 -- UTC-5 with automatic DST adjustment
            A complete list can be seen here in the second column:
            https://github.com/nayarsystems/posix_tz_db/blob/master/zones.csv
    
    config SNTP
        bool "Enable SNTP synchronization"
        default n
        depends on WIFI_MODE_STATION || WIFI_MODE_SOFTAP_STATION
        help
            By enabling this option the ESP32 will attempt to synchronize the
            system time with an external SNTP server once per hour.

    config SNTP_SERVER
        string "SNTP Server"
        default "pool.ntp.org"
        depends on SNTP
endmenu

menu "Advanced Configuration"
    config ENABLE_TASK_LIST_REPORTING
        bool "Enable TaskList reporting"
        default n
        select FREERTOS_VTASKLIST_INCLUDE_COREID
        select FREERTOS_USE_TRACE_FACILITY
        select FREERTOS_GENERATE_RUN_TIME_STATS

    config TASK_LIST_INTERVAL
        int "Task list interval (sec)"
        default 25
        depends on ENABLE_TASK_LIST_REPORTING

    config HEALTH_INTERVAL
        int "Health report interval (sec)"
        default 15

    config USE_LITTLEFS
        bool "Use LittleFS"
        default n
endmenu
```
